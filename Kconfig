## Kconfig
```kconfig
# Copyright (c) 2026 The ZMK Contributors
# SPDX-License-Identifier: MIT

config ZMK_SOFLE_ESB_BLE_COMPAT
    bool "Provide BLE-peripheral stubs for ESB split peripherals"
    default y if ZMK_SPLIT_ESB && !ZMK_SPLIT_BLE && ZMK_DISPLAY
    help
      The stock nice_view peripheral widget calls into the BLE split
      peripheral API. When the ESB split transport is used instead, that
      API is not compiled. Enable this to provide stubs so nice_view can
      link.

config ZMK_SOFLE_LS0XX
    bool "Use the vendored Sharp LS0XX driver with serial-vcom-inversion"
    default y if ZMK_DISPLAY
    help
      The Zephyr 4.1 in-tree sharp,ls0xx driver does not implement the
      serial-vcom-inversion software VCOM toggling that ZMK 0.4
      enables in the nice_view overlay (see ZMK PR #3294). Without that
      toggle the Sharp memory LCD develops a DC bias that manifests as
      rapid "refresh" flicker. Enable this option to build a vendored
      copy of the upstream LS0XX driver (post-Zephyr 4.4) that honours
      the new DT properties. The vendored driver binds to a unique
      compatible string (`zmk,sharp-ls0xx`) so it coexists with the
      Zephyr in-tree driver; config/nice_view.overlay rewrites the
      nice_view node's compatible to our string.

config ZMK_SOFLE_LS0XX_VCOM_THREAD_PRIO
    int "Priority for the LS0XX VCOM inversion thread"
    default 11
    depends on ZMK_SOFLE_LS0XX
    help
      Matches the value set by upstream ZMK 0.4 in the nice_view
      Kconfig.defconfig (LS0XX_VCOM_THREAD_PRIO=11).
```

## config/west.yml
```yaml
manifest:
  remotes:
    - name: zmkfirmware
      url-base: https://github.com/zmkfirmware
    - name: petejohanson
      url-base: https://github.com/petejohanson
    - name: gpeye
      url-base: https://github.com/GPeye
    - name: tokyo2006
      url-base: https://github.com/tokyo2006
    - name: englmaxi
      url-base: https://github.com/englmaxi
    - name: badjeff
      url-base: https://github.com/badjeff
    - name: nrfconnect
      url-base: https://github.com/nrfconnect
    - name: zzeneg # <-- required for Raw HID module
      url-base: https://github.com/zzeneg
    - name: srwi # <-- required for KeyPeek module
      url-base: https://github.com/srwi
  projects:
    - name: mario-peripheral-animation
      remote: gpeye
      revision: main 
    - name: zmk
      remote: petejohanson
      revision: core/main-work-queue
      import: app/west.yml
    - name: zmk-feature-split-esb
      remote: badjeff
      revision: main
    - name: sdk-nrf
      remote: badjeff
      revision: v3.1-branch+zmk-fixes
      path: nrf
    - name: nrfxlib
      remote: nrfconnect
      revision: v3.1-branch
      repo-path: sdk-nrfxlib
      path: nrfxlib
    - name: zmk-dongle-display
      remote: englmaxi
      revision: 44b11bb5b6a2a8ce0d0cbb89e950eb183a33197b
    - name: zmk-raw-hid # <-- Raw HID module
      remote: zzeneg
      revision: main
    - name: zmk-keypeek-layer-notifier # <-- KeyPeek module
      remote: srwi
      revision: master
  self:
    path: config
```

## dts/bindings/display/sharp,ls0xx.yaml
```yaml
# Copyright (c) 2020, Rohit Gujarathi
# SPDX-License-Identifier: Apache-2.0
#
# This is a copy of the upstream Zephyr sharp,ls0xx binding, extended with
# the `serial-vcom-inversion` and `serial-vcom-interval` properties added
# to the LS0XX driver in 2025-09 (post Zephyr 4.4). The ZMK 0.4 nice_view
# overlay sets those properties, but the Zephyr 4.1 in-tree driver does
# not declare them, so they would otherwise be rejected.
#
# This module file is searched before Zephyr's, so it overrides the
# upstream binding. The actual driver implementation lives at
# drivers/display/ls0xx.c in this repository and is selected by setting
# `CONFIG_LS0XX=n` (to disable the in-tree driver) together with
# `CONFIG_ZMK_SOFLE_LS0XX=y` (to enable our vendored copy).

description: |
    Sharp LS0XX memory display controller

    Sharp LS0XX series has an eclectic range of TFT-LCD controllers,
    mostly monochrome TFT-LCD controller up to 400x240 resolution.

    Example supported references:
    LS012B7DD01
    LS013B7DH03
    LS013B7DH05
    LS027B7DH01A
    LS032B7DD02
    LS044Q7DH01

    Adafruit 1.3" SHARP Memory LCD display is a breakout board for
    LS013B4DN04, and 2.7" for LS027B7DH01.

compatible: "sharp,ls0xx"

include: [spi-device.yaml, display-controller.yaml]

properties:
  extcomin-gpios:
    type: phandle-array
    description: EXTCOMIN pin

      The EXTCOMIN pin is where a square pulse for toggling VCOM will
      be given

  extcomin-frequency:
    type: int
    description: EXTCOMIN pin toggle frequency

      The frequency with which the EXTCOMIN pin should be toggled. See
      datasheet of particular display. Higher frequency gives better
      contrast while low frequency saves power.

  disp-en-gpios:
    type: phandle-array
    description: DISPLAY pin

      The DISPLAY pin controls if the LCD displays memory contents or
      white screen. If defined, the pin will be set high during driver
      initialization. display blanking apis can be used to control it.

  serial-vcom-inversion:
    type: boolean
    description: Send serial VCOM inversion commands

      Enable when EXTCOMIN is not configured and VCOM inversion is not
      application-managed.

  serial-vcom-interval:
    type: int
    default: 1000
    description: Serial VCOM inversion interval

      VCOM inversion interval in milliseconds. This value is used when
      there is no EXTCOMIN configured and serial-vcom inversion is set.
      If not configured, 1000ms will be used which is the minimum some
      sources recommend, though the panel datasheet may specify a more
      frequent interval and 1000ms will also be visible.
```
