/*
 * Copyright (c) 2026 The ZMK Contributors
 * SPDX-License-Identifier: MIT
 *
 * Redirect the nice_view shield's Sharp memory display to the vendored
 * driver shipped under drivers/display/ls0xx.c in this user-config
 * module. The in-tree Zephyr 4.1 sharp,ls0xx driver does not implement
 * the serial-vcom-inversion DT property that ZMK 0.4's nice_view
 * overlay sets (PR #3294); without software VCOM toggling the panel
 * accumulates a DC bias that shows up as fast "refresh" flicker on the
 * peripheral halves.
 *
 * Our driver uses a unique compatible string (`zmk,sharp-ls0xx`) to
 * avoid the binding collision Zephyr would otherwise complain about,
 * and this overlay rewrites the nice_view node so it binds to our
 * driver instead. ZMK loads this file from the config/ directory after
 * the nice_view shield overlay, so the compatible reassignment wins.
 */

&nice_view {
    compatible = "zmk,sharp-ls0xx";
    serial-vcom-inversion;
    serial-vcom-interval = <33>;
};
